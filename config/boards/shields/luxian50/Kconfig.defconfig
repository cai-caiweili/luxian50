## config/boards/shields/luxian50/Kconfig.defconfig
```kconfig
if SHIELD_LUXIAN50_LEFT

config ZMK_KEYBOARD_NAME
    default "luxian50"

config ZMK_SPLIT_ROLE_CENTRAL
    default y

endif

if SHIELD_LUXIAN50_LEFT || SHIELD_LUXIAN50_RIGHT

config ZMK_SPLIT
    default y

endif
```

## config/boards/shields/luxian50/Kconfig.shield
```kconfig
# Copyright (c) 2020 Pete Johanson
# SPDX-License-Identifier: MIT

config SHIELD_LUXIAN50_LEFT
    def_bool $(shields_list_contains,luxian50_left)

config SHIELD_LUXIAN50_RIGHT
    def_bool $(shields_list_contains,luxian50_right)
```
